## bitbake-builds/mydistro-wrynose/build/conf/bblayers.conf
```bitbake
BBLAYERS ?= " \
  ${TOPDIR}/../layers/openembedded-core/meta \
  ${TOPDIR}/../layers/meta-yocto/meta-yocto-bsp \
  ${TOPDIR}/../layers/meta-yocto/meta-poky \
  ${TOPDIR}/../layers/meta-openembedded/meta-networking \
  ${TOPDIR}/../layers/meta-openembedded/meta-python \
  ${TOPDIR}/../layers/meta-openembedded/meta-oe \
  ${TOPDIR}/../layers/meta-mydistro \
  ${TOPDIR}/../layers/meta-erlang \
  ${TOPDIR}/../layers/meta-elixir \
  "
```

## bitbake-builds/mydistro-wrynose/build/conf/local.conf
```bitbake
#
# This file is intended for local configuration tweaks.
#
# If you would like to publish and share changes made to this file,
# it is recommended to put them into a distro config, or to create
# layer fragments from changes made here.
#

SPDX_PRETTY = "1"
```

## bitbake-builds/mydistro-wrynose/layers/meta-erlang/conf/layer.conf
```bitbake
# We have a conf and classes directory, add to BBPATH
BBPATH .= ":${LAYERDIR}"

# We have recipes-* directories, add to BBFILES
BBFILES += "${LAYERDIR}/recipes-*/*/*.bb \
            ${LAYERDIR}/recipes-*/*/*.bbappend"

BBFILE_COLLECTIONS += "meta-erlang"
BBFILE_PATTERN_meta-erlang = "^${LAYERDIR}/"
BBFILE_PRIORITY_meta-erlang = "6"

LAYERDEPENDS_meta-erlang = "core"
LAYERSERIES_COMPAT_meta-erlang = "wrynose"
```

## bitbake-builds/mydistro-wrynose/layers/meta-mydistro/conf/distro/mydistro.conf
```bitbake
# ── Identity ──────────────────────────────
DISTRO        = "mydistro"
DISTRO_NAME   = "My Custom Distro"
DISTRO_VERSION = "1.0"

# ── C Library: glibc (the default, explicit here for clarity) ──
TCLIBC = "glibc"

# Generate the UTF-8 locale specifically
GLIBC_GENERATE_LOCALES = "en_US.UTF-8"
# Include the locale packages in the image
IMAGE_INSTALL:append = " glibc-utils localedef"
# Set the default locale for the image
IMAGE_LINGUAS = "en-us"
# Disable the test suites that are causing the locale errors with glibc
# Put it back to test a BSP or compatibility, then remove it
DISTRO_FEATURES:remove = "ptest"
# Disable the test suites that are causing the locale errors with glibc
# Put it back to test a BSP or compatibility, then remove it
DISTRO_FEATURES:remove = "ptest"

# ── Only the features you actually need ───
DISTRO_FEATURES = "ext2 ext3 ext4 ipv4 ipv6 security"

# ── Remove everything you don't need ──────
DISTRO_FEATURES:remove = " \
    x11 wayland opengl vulkan \
    bluetooth wifi nfc 3g \
    pulseaudio alsa \
    nfs pci \
"

# ── Compiler hardening flags ───────────────
CFLAGS:append   = " -fstack-protector-strong -D_FORTIFY_SOURCE=2"
LDFLAGS:append  = " -Wl,-z,relro -Wl,-z,now"

# ── No debug output in production ─────────
DISTRO_FEATURES:remove = "debuginfod"

# -------------------------------------------------------------
# added after the initial generation

# ── My custom settings ──────────────────────
DISTRO   = "mydistro"
MACHINE  = "qemux86-64"

# Force the compiler to use the x86-64-v3 instruction set
# most Intel and AMD CPUS support it to go faster
#
# runqemu for the VM will in theory need a new parameter qemuparams="-cpu host"
# but it practice libvirt is smart by default without using this parameter
# To check activation:
# grep -E "avx2|bmi2" /proc/cpuinfo
# qemux86-64:~$ /lib/ld-linux-x86-64.so.2 --help | grep -E "v3|supported"
#  x86-64-v3 (supported, searched)
#  x86-64-v2 (supported, searched)
DEFAULTTUNE = "x86-64-v3"

# qemu-specific
MACHINE_FEATURES:append = " qemu-usermode"

PREFERRED_PROVIDER_virtual/kernel = "linux-kernel7"

IMAGE_FSTYPES     = "ext4"

# wrynose version of poky uses a new way for sbom/cve:
# bitbake-config-build enable-fragment core/yocto/sbom-cve-check
# we kept commented the old way for documentation purpose
# generate the SBOM report of dependencies
#INHERIT += "create-spdx"
# generate the CVE report of vulnerabilities
#INHERIT += "cve-check"
#CVE_CHECK_FORMAT_JSON = "1"
#CVE_CHECK_REPORT_PATCHED = "0"

# Don't report CVEs for host-only build tools
CVE_CHECK_SKIP_RECIPE += " \
    libarchive-native \
    curl-native \
    perl-native \
    python3-native \
    openssl-native \
    qemu-native \
    expat-native \
    libgcrypt-native \
    ncurses-native \
    sqlite3-native \
    util-linux-native \
    xz-native \
    pbzip2-native \
    binutils-cross-x86_64 \
    libcap-native \
"

# Globally ignored CVEs (disputed, not applicable, or false positives)
CVE_STATUS[CVE-1999-0524] = "disputed"
CVE_STATUS[CVE-1999-0656] = "not-applicable-config"
CVE_STATUS:x86-64[CVE-2006-2932] = "not-applicable-config"
CVE_STATUS:aarch64[CVE-2006-2932] = "not-applicable-platform"
CVE_STATUS[CVE-2007-2764] = "not-applicable-config"
CVE_STATUS[CVE-2007-4998] = "disputed"
CVE_STATUS[CVE-2008-2544] = "disputed"
CVE_STATUS[CVE-2008-4609] = "disputed"
CVE_STATUS[CVE-2010-4563] = "disputed"
CVE_STATUS[CVE-2010-4756] = "disputed"

# This controls the device name prefix
# qemu-specific
QB_DRIVE_TYPE = "/dev/vda"

# This ensures the kernel knows where to look for the rootfs
# qemu-specific
QB_KERNEL_CMDLINE_APPEND = "root=/dev/vda rw"

# temporary to speed up the build
INHERIT:remove = "create-spdx"

# to have the command ip
IMAGE_INSTALL:append = " iproute2"

# this will be processed by meta-erlang
#ERLANG_VERSION = "28.5"
ERLANG_VERSION = "29.0"
ELIXIR_VERSION = "1.19.5"
BBMASK:append = " ${@'/erlang_(?!' + d.getVar('ERLANG_VERSION').replace('.', '\.') + ')[^/]*\.bb$'}"
BBMASK:append = " ${@'/elixir_(?!' + d.getVar('ELIXIR_VERSION').replace('.', '\.') + ')[^/]*\.bb$'}"

# replace openssl by wolfssl
PREFERRED_PROVIDER_virtual/crypt = "wolfssl"
PREFERRED_PROVIDER_virtual/openssl = "wolfssl"
PREFERRED_PROVIDER_virtual/openssl-native = "wolfssl-native"
PREFERRED_PROVIDER_virtual/crypt-native = "wolfssl-native"

PREFERRED_PROVIDER_openssl-native = "wolfssl-native"
PREFERRED_PROVIDER_openssl-nativesdk = "wolfssl-nativesdk"

# remove the original openssl
BBMASK += "meta/recipes-connectivity/openssl/"
```

## build/conf/bblayers.conf
```bitbake
# POKY_BBLAYERS_CONF_VERSION is increased each time build/conf/bblayers.conf
# changes incompatibly
POKY_BBLAYERS_CONF_VERSION = "2"

BBPATH = "${TOPDIR}"
BBFILES ?= ""

BBLAYERS ?= " \
  /home/user/Documents/yocto/poky/meta \
  /home/user/Documents/yocto/poky/meta-poky \
  /home/user/Documents/yocto/poky/meta-yocto-bsp \
  "
```

## meta-mydistro/conf/distro/mydistro.conf
```bitbake
# ── Identity ──────────────────────────────
DISTRO        = "mydistro"
DISTRO_NAME   = "My Custom Distro"
DISTRO_VERSION = "1.0"

# ── C Library: glibc (the default, explicit here for clarity) ──
TCLIBC = "glibc"

# ── Only the features you actually need ───
DISTRO_FEATURES = "ext2 ext3 ext4 ipv4 ipv6 security"

# ── Remove everything you don't need ──────
DISTRO_FEATURES:remove = " \
    x11 wayland opengl vulkan \
    bluetooth wifi nfc 3g \
    pulseaudio alsa \
    nfs pci \
"

# ── Compiler hardening flags ───────────────
CFLAGS:append   = " -fstack-protector-strong -D_FORTIFY_SOURCE=2"
LDFLAGS:append  = " -Wl,-z,relro -Wl,-z,now"

# ── No debug output in production ─────────
DISTRO_FEATURES:remove = "debuginfod"
```
